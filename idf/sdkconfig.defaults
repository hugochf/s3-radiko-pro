## idf/sdkconfig.defaults
```kconfig
# sdkconfig.defaults — the ONLY committed config. sdkconfig itself is generated
# and gitignored, so the deltas from IDF defaults stay small and reviewable
# (PLAN.md workflow rule 5). Keep this file minimal: only what the hardware or
# the build layout requires. Feature flags get added in the phase that needs them.

# --- Target ---
CONFIG_IDF_TARGET="esp32s3"

# --- Flash: lcdwiki ES3C28P has 16 MB, QIO @ 80 MHz ---
CONFIG_ESPTOOLPY_FLASHSIZE_16MB=y
CONFIG_ESPTOOLPY_FLASHMODE_QIO=y
CONFIG_ESPTOOLPY_FLASHFREQ_80M=y

# --- PSRAM: 8 MB Octal (OPI) @ 80 MHz. Mandatory for the audio pipeline later. ---
CONFIG_SPIRAM=y
CONFIG_SPIRAM_MODE_OCT=y
CONFIG_SPIRAM_SPEED_80M=y

# --- Custom dual-OTA partition table ---
CONFIG_PARTITION_TABLE_CUSTOM=y
CONFIG_PARTITION_TABLE_CUSTOM_FILENAME="partitions.csv"

# --- Console over the board's native USB (USB-Serial-JTAG), so one cable does
#     flashing + `idf.py monitor` + JTAG debug (Phase 24). ---
CONFIG_ESP_CONSOLE_USB_SERIAL_JTAG=y

# --- LVGL (v9, configured via Kconfig): RGB565 to match the ILI9341. ---
CONFIG_LV_COLOR_DEPTH_16=y
# LVGL's allocator gets ONE pool, carved from internal RAM at link time
# (LV_MEM_SIZE, 64 KB default). That pool is the whole UI's budget — every
# object, style and draw mask. The resident screens already sat at ~77% of it,
# so opening WiFi setup + a 20-AP scan list hit exactly 100%: lv_malloc returned
# NULL and LVGL's default assert handler is `while(1);`, freezing the LVGL task
# until the watchdog rebooted (Phase 31). Internal RAM can't fund a bigger pool
# — only ~30 KB is free at runtime (WiFi/LWIP own the rest), largest block
# ~10 KB. So ui_init() adds a 256 KB spill pool in PSRAM via lv_mem_add_pool().
# THIS setting is what makes that legal: TLSF sizes its index tables at COMPILE
# time from (LV_MEM_SIZE + LV_MEM_POOL_EXPAND_SIZE), and silently rejects any
# pool bigger than 1<<log2ceil(that). At 0 the cap is 64 KB and the 256 KB pool
# was refused; 256 raises the cap to 512 KB. It reserves index capacity only —
# it allocates nothing by itself.
CONFIG_LV_MEM_POOL_EXPAND_SIZE_KILOBYTES=256
# The LED/car visualiser bar (Phase 32) is one static green->amber->red gradient
# per band, masked from the top by a shutter — that's what makes the colour track
# ABSOLUTE height (a short bar all green) instead of stretching over each bar.
# It needs three stops; LVGL's default cap of 2 would force a green->red blend
# straight through olive.
CONFIG_LV_GRADIENT_MAX_STOPS=3
# Screen-saver clock (Phase 16): 48 pt for HH:MM, 16 pt for the date line.
CONFIG_LV_FONT_MONTSERRAT_16=y
CONFIG_LV_FONT_MONTSERRAT_48=y
# JP font: 2 bpp UNCOMPRESSED (the proven-stable config used all project).
# NOTE: 3 bpp compressed (LV_USE_FONT_COMPRESSED + LV_FONT_FMT_TXT_LARGE) was
# tried for smoothness and caused HEAP CORRUPTION — crashes across unrelated
# tasks (led, lvgl) with garbage backtraces, watchdog reboots. Reverted. If
# smoother JP text is ever wanted again, move the font to its own partition
# and load it as a runtime binary font, don't flip the global compressed/large
# flags (they change LVGL's glyph-draw machinery for every font).

# --- Crash diagnostics (added while debugging the Phase 13 logo hang; keep for
#     the Tier D crash-dump work) ---
# Hardware watchpoint at each task's stack end: an overflow faults immediately
# (debug exception -> panic + backtrace) instead of silently corrupting memory
# and wedging the whole chip with no serial output. Stronger than the default
# canary, which only validates at context-switch time and misses violent overflows.
CONFIG_FREERTOS_WATCHPOINT_END_OF_STACK=y
# Save an ELF coredump to the dedicated coredump flash partition so a crash can
# be inspected after reboot with `idf.py coredump-info` / `coredump-debug`.
CONFIG_ESP_COREDUMP_ENABLE_TO_FLASH=y
CONFIG_ESP_COREDUMP_DATA_FORMAT_ELF=y
CONFIG_ESP_COREDUMP_CHECKSUM_CRC32=y

# --- TLS memory: internal RAM is tight and mbedtls needs a 16 KB *contiguous*
#     block for each of its RX/TX record buffers. The RX (IN) buffer must stay
#     16 KB — the Radiko CDN sends full-size TLS records (a smaller IN buffer
#     fails segment reads with -0x7100). But our requests are tiny HTTP GETs, so
#     the TX (OUT) buffer can shrink from 16 KB to 4 KB. Asymmetric content-len
#     lets IN and OUT differ; this frees ~12 KB per TLS session and removes a
#     second 16 KB-contiguous requirement, which was intermittently failing the
#     stream's TLS handshake (create_ssl / connect timeout) once auth's TLS churn
#     had fragmented the heap below 16 KB. ---
CONFIG_MBEDTLS_ASYMMETRIC_CONTENT_LEN=y
CONFIG_MBEDTLS_SSL_IN_CONTENT_LEN=16384
CONFIG_MBEDTLS_SSL_OUT_CONTENT_LEN=4096
# Allocate ALL mbedtls buffers from PSRAM. Even with the OUT buffer shrunk, the
# 16 KB IN buffer still needs contiguous internal RAM, and whether a ≥16 KB block
# survives boot-time allocation churn varies run to run — some boots streamed
# fine, others failed TLS forever (largest block stuck at ~15 KB). PSRAM ends
# that class of failure outright; the modest TLS slowdown is irrelevant at
# 160 kbps stream bitrate.
CONFIG_MBEDTLS_EXTERNAL_MEM_ALLOC=y

# --- OTA rollback (Phase 22) ---
# An OTA-installed image boots as PENDING_VERIFY; unless the app marks itself
# valid (main does so after 30 s alive), the NEXT reset rolls back to the
# previous slot. Pairs with the task watchdog: a wedge in fresh firmware
# panics within 15 s -> reboot -> automatic downgrade. Self-healing updates.
CONFIG_BOOTLOADER_APP_ROLLBACK_ENABLE=y

# --- Watchdogs (Phase 18) ---
# A starved task watchdog PANICS instead of printing forever: with coredump-to-
# flash enabled the wedge is preserved for post-mortem and the radio reboots
# back to playing. The Phase 17 LVGL wedge sat frozen for minutes under the
# default print-only policy. Timeout + subscriptions are set at runtime in
# components/app_watchdog (15 s — must clear the fetcher's 10 s HTTP timeout).
CONFIG_ESP_TASK_WDT_PANIC=y

# The WS2812 mood LED refreshes via RMT every 20 ms. Its ISR must live in IRAM:
# a non-IRAM RMT interrupt firing during an NVS flash write (cache disabled)
# wedges the chip — same failure class as the Phase 13 touch-INT bug, seen as
# intermittent touch loss / full hangs.
CONFIG_RMT_ISR_IRAM_SAFE=y
```
